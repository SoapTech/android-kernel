## linux/modules/drivers/gpio/Kconfig
```kconfig
config GPIO_CRYSTALCOVE
	bool "Intel ValleyView Crystalcove GPIO support"
	select IRQ_DOMAIN
	help
	  This driver is for Intel ValleyView.

	  Say Y here to support Intel ValleyView Crystalcove GPIO.

config GPIO_VALLEYVIEW2
	bool "Intel ValleyView GPIO support"
	select IRQ_DOMAIN
	help
	  This driver is for Intel ValleyView.

	  Say Y here to support Intel ValleyView GPIO.
```

## linux/modules/drivers/i2c/busses/Kconfig
```kconfig
#
# I2C buses device configuration
#

config I2C_DESIGNWARE_PCI_FORK
	tristate "Synopsys DesignWare PCI"
	depends on PCI
	help
	  If you say yes to this option, support will be included for the
	  Synopsys DesignWare I2C adapter. Only master mode is supported.

	  This driver can also be built as a module.  If so, the module
	  will be called i2c-designware-pci.
```

## linux/modules/drivers/input/touchscreen/Kconfig
```kconfig
config TOUCHSCREEN_ATMEL_MXT224
	tristate "ATMEL mXT224 touchscreen"
	depends on I2C
	default n
	help
		Say Y here if you have a mXT224 touchscreen
		If unsure, say N.

config TOUCHSCREEN_R69001_I2C
	tristate "JDI R69001 touchscreen"
	depends on I2C
	default n
	help
		Say Y here if you have a R69001 touchscreen
		If unsure, say N.

source "../modules/drivers/input/touchscreen/rmi4/Kconfig"
```

## linux/modules/drivers/misc/Kconfig
```kconfig
config A1026
	tristate "Audience a1026/eS305 Voice Processor"
	depends on I2C && INTEL_SCU_IPC
	help
	  Provides an interface to the Audience voice processing
	  unit via an I2C bus interface.

	  To compile this driver as a module, choose M here: the module will
	  be called a1026.

config SCU_LOGGING
	tristate "Intel SCU fabric debug driver"
	default n
	---help---
	 Driver that enable for debugging Intel SCU firmware fabric related error.

config UUID
	tristate "get uuid"
	default n
	---help---
	 Driver for get UUID.

source "../modules/drivers/misc/bcm-lpm/Kconfig"
source "../modules/drivers/misc/ti-st/Kconfig"
```

## linux/modules/drivers/power/Kconfig
```kconfig
config CHARGER_BQ24192
	tristate "TI BQ24192/BQ24191/BQ24190 Charger"
	select POWER_SUPPLY_CHARGER
	depends on I2C
	help
	  BQ24192 is the charger chip for lithium-ion (Li+) batteries
	  in handheld and portable equipment.

	  Say Y here if you know your platform has this chip for charging
	  support.
```

## linux/modules/drivers/staging/Kconfig
```kconfig
source "../modules/drivers/staging/matrix/Kconfig"
source "../modules/drivers/staging/sep/Kconfig"
```
